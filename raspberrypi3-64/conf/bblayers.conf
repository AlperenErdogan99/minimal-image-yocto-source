## raspberrypi3-64/conf/bblayers.conf
```bitbake
# POKY_BBLAYERS_CONF_VERSION is increased each time build/conf/bblayers.conf
# changes incompatibly
POKY_BBLAYERS_CONF_VERSION = "2"

BBPATH = "${TOPDIR}"
BBFILES ?= ""

BBLAYERS ?= " \
  /home/alperen/workspace/yocto-env/sources/poky/meta \
  /home/alperen/workspace/yocto-env/sources/poky/meta-poky \
  /home/alperen/workspace/yocto-env/sources/poky/meta-yocto-bsp \
  /home/alperen/workspace/yocto-env/sources/meta-raspberrypi \
  /home/alperen/workspace/yocto-env/sources/meta-openembedded/meta-oe \
  /home/alperen/workspace/yocto-env/sources/meta-openembedded/meta-multimedia \
  /home/alperen/workspace/yocto-env/sources/meta-openembedded/meta-networking \
  /home/alperen/workspace/yocto-env/sources/meta-openembedded/meta-python \
  /home/alperen/workspace/yocto-env/sources/meta-alex \
  /home/alperen/workspace/yocto-env/sources/meta-qt5 \
  "
```

## sources/meta-alex/conf/layer.conf
```bitbake
# We have a conf and classes directory, add to BBPATH
BBPATH .= ":${LAYERDIR}"

# We have recipes-* directories, add to BBFILES
BBFILES += "${LAYERDIR}/recipes-*/*/*.bb \
            ${LAYERDIR}/recipes-*/*/*.bbappend"

BBFILE_COLLECTIONS += "meta-alex"
BBFILE_PATTERN_meta-alex = "^${LAYERDIR}/"
BBFILE_PRIORITY_meta-alex = "6"

LAYERDEPENDS_meta-alex = "core"
LAYERSERIES_COMPAT_meta-alex = "dunfell"
```
